## sdkconfig.defaults
```kconfig
#
# Enable BLE and Bluedroid stack
#
CONFIG_BT_ENABLED=y
CONFIG_BLUEDROID_ENABLED=y
CONFIG_BTDM_CONTROLLER_MODE_BLE_ONLY=y
CONFIG_BT_BLE_ENABLED=y

#
# Set flash size to 2MB to match your board
#
# CONFIG_ESPTOOLPY_FLASHSIZE="2MB"

#
# Configuration for i2cdev lib
#
CONFIG_I2CDEV_TIMEOUT=1000
```
